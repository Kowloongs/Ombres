// SPDX-License-Identifier: (GPL-2.0+ OR MIT)
/*
 * FriendlyElec NanoPi M4 board device tree source
 *
 * Copyright (c) 2018 FriendlyElec Computer Tech. Co., Ltd.
 * (http://www.friendlyarm.com)
 *
 * Copyright (c) 2018 Collabora Ltd.
 * Copyright (c) 2019 Arm Ltd.
 */

/dts-v1/;
#include "rk3568-evb1-ddr4-v10.dtsi"

/ {
	model = "Ombres MonoPi R5S";
	compatible = "ombres,monopi-r5s", "rockchip,rk3568-evb1-ddr4-v10", "rockchip,rk3568";
};

